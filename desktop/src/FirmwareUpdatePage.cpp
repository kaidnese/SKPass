#include "FirmwareUpdatePage.h"
#include "FirmwareImage.h"
#include "SerialReader.h"
#include "RomDownloadPanel.h"
#include <QTabWidget>
#include <QTabBar>
#include <QFile>
#include <QDir>
#include <QFileDialog>
#include <QLabel>
#include <QPushButton>
#include <QProgressBar>
#include <QVBoxLayout>
#include <QStorageInfo>
#include <QThread>
#include <QTimer>
#include <QElapsedTimer>
#include <QPointer>
#include <QDragEnterEvent>
#include <QDragLeaveEvent>
#include <QDropEvent>
#include <QMimeData>
#include <QUrl>
#include <QFileInfo>
#include <QPainter>
#include <QStyle>
#include <QFrame>
#include <QMouseEvent>
#include <QKeyEvent>
#include <QScrollArea>
#include <QHBoxLayout>
#include <functional>
#include <memory>
#ifdef Q_OS_WIN
#ifndef NOMINMAX
#define NOMINMAX
#endif
#include <windows.h>
#endif

namespace {
QPixmap uploadIcon() {
    QPixmap icon(104,104);icon.setDevicePixelRatio(2);icon.fill(Qt::transparent);
    QPainter p(&icon);p.setRenderHint(QPainter::Antialiasing);
    p.setPen(Qt::NoPen);p.setBrush(QColor("#e6efff"));p.drawEllipse(QRectF(0,0,52,52));
    p.setPen(QPen(QColor("#2563eb"),2.3,Qt::SolidLine,Qt::RoundCap,Qt::RoundJoin));
    p.drawLine(QPointF(26,31),QPointF(26,15));
    p.drawLine(QPointF(19,22),QPointF(26,15));p.drawLine(QPointF(26,15),QPointF(33,22));
    p.drawLine(QPointF(15,30),QPointF(15,37));p.drawLine(QPointF(15,37),QPointF(37,37));p.drawLine(QPointF(37,37),QPointF(37,30));
    return icon;
}
// Bypass Windows' file-data cache: STATUS.TXT is generated by the device.
QByteArray deviceStatus(const QString &root) {
#ifdef Q_OS_WIN
    QString path=QDir::toNativeSeparators(QDir(root).filePath("STATUS.TXT"));
    HANDLE h=CreateFileW(reinterpret_cast<LPCWSTR>(path.utf16()),GENERIC_READ,
                         FILE_SHARE_READ|FILE_SHARE_WRITE,nullptr,OPEN_EXISTING,FILE_FLAG_NO_BUFFERING,nullptr);
    if(h==INVALID_HANDLE_VALUE)return {};
    void *buffer=VirtualAlloc(nullptr,4096,MEM_COMMIT|MEM_RESERVE,PAGE_READWRITE);
    DWORD count=0;QByteArray result;
    if(buffer && ReadFile(h,buffer,512,&count,nullptr))result=QByteArray(static_cast<char *>(buffer),int(count));
    if(buffer)VirtualFree(buffer,0,MEM_RELEASE);CloseHandle(h);return result;
#else
    QFile f(QDir(root).filePath("STATUS.TXT"));return f.open(QIODevice::ReadOnly)?f.read(512):QByteArray();
#endif
}
QString copyFirmware(const QString &root,const QByteArray &data,const std::function<void(int)> &report) {
    const QString destination=QDir(root).filePath("FIRMWARE.UF2");
#ifdef Q_OS_WIN
    const QString path=QDir::toNativeSeparators(destination);
    HANDLE h=CreateFileW(reinterpret_cast<LPCWSTR>(path.utf16()),GENERIC_WRITE,FILE_SHARE_READ,nullptr,
                         CREATE_ALWAYS,FILE_ATTRIBUTE_NORMAL|FILE_FLAG_WRITE_THROUGH,nullptr);
    if(h==INVALID_HANDLE_VALUE)return QStringLiteral("无法打开 UF2 磁盘，Windows 错误 %1。 ").arg(GetLastError());
    bool ok=true;int sent=0;
    while(sent<data.size()) {
        DWORD written=0;DWORD n=DWORD(qMin(qsizetype(16384),data.size()-sent));
        if(!WriteFile(h,data.constData()+sent,n,&written,nullptr) || written!=n){ok=false;break;}
        sent+=int(written);report(int(sent*95LL/data.size()));
    }
    if(ok)ok=FlushFileBuffers(h);CloseHandle(h);
    if(!ok)return QStringLiteral("固件复制/落盘失败。请查看 STATUS.TXT；重新插拔后重试，不能认为更新成功。 ");
#else
    QFile f(destination);if(!f.open(QIODevice::WriteOnly) || f.write(data)!=data.size() || !f.flush())return QStringLiteral("固件复制失败。 ");f.close();report(95);
#endif
    QElapsedTimer wait;wait.start();
    while(wait.elapsed()<15000) {
        QByteArray state=deviceStatus(root);
        if(state.startsWith("COMPLETE"))return {};
        if(state.startsWith("ERROR:"))return QString::fromLatin1(state.split('\0').value(0));
        QThread::msleep(250);
    }
    return QStringLiteral("文件已发送，但未收到设备 COMPLETE 确认。请检查磁盘中的 STATUS.TXT，不要视为更新成功。 ");
}
struct UpdateResult {QString error;bool automaticRestart=false;};
QString prepareAndCopy(const QString &path,const std::function<void(int)> &report,bool &automaticRestart) {
    QFile file(path);
    if(!file.open(QIODevice::ReadOnly) || file.size()>FirmwareImage::MaxSize*2)
        return QStringLiteral("无法读取固件或文件过大。");
    QString error;
    auto image=FirmwareImage::prepare(file.readAll(),path.endsWith(".uf2",Qt::CaseInsensitive),&error);
    if(image.isEmpty())return error;
    // Windows can stall volume discovery and reads when USB is changing modes.
    // Keep every disk operation on the worker, including checking STATUS.TXT.
    QStringList disks;
    for(const auto &volume:QStorageInfo::mountedVolumes()) {
        if(!volume.isValid() || !volume.isReady() || volume.isReadOnly())continue;
        QFile info(QDir(volume.rootPath()).filePath("INFO_UF2.TXT"));
        if(info.open(QIODevice::ReadOnly)) {
            const auto identity=info.read(512);
            if(identity.contains(QByteArray("Board-ID: ")+FirmwareImage::Board) ||
               identity.contains("Board-ID: CARDIO-S3-N16R8-UF2-V1")) {
                disks<<volume.rootPath();
                automaticRestart=identity.contains("AutoRestart: after COMPLETE is read;");
            }
        }
    }
    if(disks.size()!=1)return disks.isEmpty()?QStringLiteral("没有发现 SKPass UF2 磁盘，请进入更新模式并等待 Windows 挂载。"):QStringLiteral("发现多台 SKPass 更新设备，请只保留一台再更新。");
    QByteArray state=deviceStatus(disks.first());
    if(!state.startsWith("READY"))return QStringLiteral("设备不是 READY 状态，请重新插拔后进入更新模式。\n")+QString::fromLatin1(state.split('\0').value(0));
    return copyFirmware(disks.first(),image,report);
}
}

FirmwareUpdatePage::FirmwareUpdatePage(SerialReader *r,QWidget *parent):QWidget(parent),reader(r) {
    setAcceptDrops(true);
    requestTimeout=new QTimer(this);requestTimeout->setSingleShot(true);requestTimeout->setInterval(8000);
    connect(requestTimeout,&QTimer::timeout,this,[this]{
        requested=false;refreshButtons();
        status->setText(QStringLiteral("未收到进入更新模式的确认。若 SKPASS_UF2 磁盘已出现，可选择或拖入固件；否则请重新插拔并连接后重试。"));
    });
    auto outer=new QVBoxLayout(this);outer->setContentsMargins(0,0,0,0);
    auto scroll=new QScrollArea;scroll->setWidgetResizable(true);scroll->setFrameShape(QFrame::NoFrame);
    auto content=new QWidget;scroll->setWidget(content);outer->addWidget(scroll);
    auto layout=new QVBoxLayout(content);layout->setContentsMargins(0,8,8,0);layout->setSpacing(18);
    auto title=new QLabel(QStringLiteral("固件更新"));title->setProperty("role","pageTitle");layout->addWidget(title);
    auto description=new QLabel(QStringLiteral("支持 UF2 磁盘更新和 ROM 串口下载（原生 USB / UART0）。更新期间停止读卡；UF2 成功后自动重启，ROM 串口烧录完成后请重新插拔 USB。设备信息仅在点击查询时获取。"));description->setWordWrap(true);description->setProperty("role","muted");layout->addWidget(description);
    auto infoCard=new QFrame;infoCard->setObjectName("deviceInformationCard");
    infoCard->setStyleSheet("QFrame#deviceInformationCard {background:#f4f8ff;border:1px solid #d9e5f5;border-radius:12px;}");
    auto infoLayout=new QVBoxLayout(infoCard);infoLayout->setContentsMargins(16,12,16,12);infoLayout->setSpacing(8);
    auto infoHeader=new QHBoxLayout;
    auto infoTitle=new QLabel(QStringLiteral("设备信息"));infoTitle->setStyleSheet("font-size:15px;font-weight:600;");
    queryInfo=new QPushButton(QStringLiteral("获取设备信息"));queryInfo->setObjectName("queryDeviceInfo");
    infoHeader->addWidget(infoTitle);infoHeader->addStretch();infoHeader->addWidget(queryInfo);infoLayout->addLayout(infoHeader);
    infoStatus=new QLabel(QStringLiteral("连接读卡器后点击查询，不会进入更新模式。"));infoStatus->setObjectName("deviceInfoStatus");infoStatus->setWordWrap(true);
    infoDetails=new QLabel;infoDetails->setObjectName("deviceInfoDetails");infoDetails->setTextFormat(Qt::PlainText);infoDetails->setWordWrap(true);
    infoDetails->setTextInteractionFlags(Qt::TextSelectableByMouse);infoDetails->hide();
    infoLayout->addWidget(infoStatus);infoLayout->addWidget(infoDetails);layout->addWidget(infoCard);
    auto tabs=new QTabWidget;tabs->setObjectName("firmwareMethods");layout->addWidget(tabs);
    auto uf2=new QWidget;tabs->addTab(uf2,QStringLiteral("UF2 磁盘更新"));
    rom=new RomDownloadPanel(reader);tabs->addTab(rom,QStringLiteral("ROM 串口下载"));
    layout=new QVBoxLayout(uf2);layout->setContentsMargins(16,16,16,16);layout->setSpacing(16);
    auto uf2Note=new QLabel(QStringLiteral("进入后出现 SKPASS_UF2 磁盘。当前更新器校验成功会自动重启；早期更新器需手动复位。退出未完成的更新时，请按 RESET 或断开全部供电（含外部 5V）后重插。"));uf2Note->setWordWrap(true);layout->addWidget(uf2Note);
    enter=new QPushButton(QStringLiteral("1. 进入 UF2 MSC 更新模式"));enter->setProperty("role","primary");enter->setEnabled(reader->canUpdate());layout->addWidget(enter);
    auto stepTitle=new QLabel(QStringLiteral("2. 添加应用固件"));stepTitle->setStyleSheet("font-size:15px;font-weight:600;");layout->addWidget(stepTitle);
    dropZone=new QFrame;dropZone->setObjectName("firmwareDropZone");dropZone->setMinimumHeight(260);
    dropZone->setSizePolicy(QSizePolicy::Preferred,QSizePolicy::Fixed);
    dropZone->setCursor(Qt::PointingHandCursor);dropZone->setFocusPolicy(Qt::StrongFocus);dropZone->installEventFilter(this);
    dropZone->setAccessibleName(QStringLiteral("拖入固件或点击选择文件"));
    dropZone->setAccessibleDescription(QStringLiteral("支持单个 BIN 或 UF2 应用固件，选择后开始校验并更新。"));
    dropZone->setStyleSheet(R"(
        QFrame#firmwareDropZone {background:#ffffff;border:2px dashed #b8cae4;border-radius:16px;}
        QFrame#firmwareDropZone:hover, QFrame#firmwareDropZone:focus {background:#f4f8ff;border-color:#5b8def;}
        QFrame#firmwareDropZone[dragActive="true"] {background:#eaf2ff;border:2px solid #2563eb;}
        QFrame#firmwareDropZone[unavailable="true"] {background:#f0f4f9;border-color:#d2dce9;}
    )");
    auto dropLayout=new QVBoxLayout(dropZone);dropLayout->setContentsMargins(24,22,24,22);dropLayout->setSpacing(10);
    auto icon=new QLabel;icon->setPixmap(uploadIcon());icon->setAlignment(Qt::AlignCenter);
    dropTitle=new QLabel;dropTitle->setAlignment(Qt::AlignCenter);dropTitle->setStyleSheet("font-size:20px;font-weight:600;color:#203b61;");
    dropDetails=new QLabel;dropDetails->setAlignment(Qt::AlignCenter);dropDetails->setWordWrap(true);dropDetails->setTextFormat(Qt::PlainText);
    dropDetails->setStyleSheet("color:#64748b;font-size:13px;");
    dropAction=new QLabel;dropAction->setAlignment(Qt::AlignCenter);dropAction->setStyleSheet("color:#2563eb;font-size:14px;font-weight:600;");
    dropLayout->addStretch();dropLayout->addWidget(icon);dropLayout->addWidget(dropTitle);dropLayout->addWidget(dropDetails);dropLayout->addWidget(dropAction);dropLayout->addStretch();
    choose=new QPushButton(QStringLiteral("选择固件文件"));choose->setObjectName("chooseFirmware");choose->setCursor(Qt::PointingHandCursor);
    dropLayout->insertWidget(dropLayout->count()-1,choose,0,Qt::AlignHCenter);
    for(auto label:{icon,dropTitle,dropDetails,dropAction})label->setAttribute(Qt::WA_TransparentForMouseEvents);
    refreshDropZone();layout->addWidget(dropZone);
    auto note=new QLabel(QStringLiteral("首次使用：请先完整烧录本工程的固件与分区表。后续选择 build/SKPass.bin 即可，程序会校验并转换为 UF2。请勿选择 bootloader.bin、分区表或合并镜像。"));note->setWordWrap(true);layout->addWidget(note);
    progress=new QProgressBar;progress->setObjectName("uf2Progress");progress->setRange(0,100);progress->setValue(0);layout->addWidget(progress);
    status=new QLabel(QStringLiteral("连接支持 UF2 的 SKPass 固件后即可进入更新模式。"));status->setObjectName("firmwareStatus");status->setWordWrap(true);layout->addWidget(status);layout->addStretch();
    connect(reader,&SerialReader::availabilityChanged,this,[this](bool){refreshButtons();});
    connect(queryInfo,&QPushButton::clicked,this,[this]{
        QString error;
        if(!reader->requestDeviceInfo(&error)){infoStatus->setStyleSheet("color:#b42318;");infoStatus->setText(error);return;}
        beginDeviceQuery();
    });
    connect(reader,&SerialReader::deviceInfoChanged,this,&FirmwareUpdatePage::showDeviceInformation);
    connect(reader,&SerialReader::deviceInfoFailed,this,[this](const QString &error){
        infoQueryPending=false;infoDetails->clear();infoDetails->hide();
        infoStatus->setStyleSheet("color:#b42318;");infoStatus->setText(error);refreshButtons();
    });
    connect(enter,&QPushButton::clicked,this,[this]{QString error;if(!reader->enterFirmwareUpdate(&error)){status->setText(error);return;}requested=true;refreshButtons();status->setStyleSheet({});status->setText(QStringLiteral("命令已发送，等待设备确认并切换为 UF2 磁盘……"));requestTimeout->start();});
    connect(reader,&SerialReader::frame,this,[this](quint8 msg,const QByteArray &p,const QByteArray &){
        if(msg!=0xB0 || p.size()!=1 || !requested)return;
        requestTimeout->stop();requested=false;
        if(p[0]==0){requested=false;reader->stop();status->setText(QStringLiteral("设备已确认，正在切换 USB。等待 SKPASS_UF2 磁盘出现。"));}
        else {requested=false;enter->setEnabled(reader->canUpdate());status->setText(p[0]==1?QStringLiteral("正在写卡，请等待写卡操作结束再更新。 "):QStringLiteral("设备拒绝更新请求，请检查 OTA 分区。 "));}
        refreshButtons();
    });
    connect(choose,&QPushButton::clicked,this,&FirmwareUpdatePage::install);
    connect(rom,&RomDownloadPanel::busyChanged,this,[this,tabs](bool active){romBusy=active;tabs->tabBar()->setEnabled(!active);refreshButtons();});
    connect(tabs,&QTabWidget::currentChanged,this,[this](int index){selectedMethod=index;});
    refreshButtons();
}
void FirmwareUpdatePage::beginDeviceQuery() {
    infoQueryPending=true;infoDetails->hide();infoStatus->setStyleSheet("color:#2563eb;");
    infoStatus->setText(QStringLiteral("正在查询设备信息…"));refreshButtons();
}
void FirmwareUpdatePage::showDeviceInformation(QJsonObject info) {
    if(info.isEmpty()) {
        infoDetails->clear();infoDetails->hide();infoQueryPending=false;
        infoStatus->setStyleSheet({});infoStatus->setText(QStringLiteral("设备连接或身份已变化，请连接后重新查询。"));refreshButtons();return;
    }
    if(!infoQueryPending)return;
    infoQueryPending=false;
    const auto hash=info.value("app_sha256").toString();
    const auto state=info.value("nfc_state").toString();
    QString nfc=state;
    if(state=="ready")nfc=QStringLiteral("RF 发现就绪");
    else if(state=="reading")nfc=QStringLiteral("读写处理中");
    else if(state=="recovering")nfc=QStringLiteral("恢复中");
    else if(state=="initializing")nfc=QStringLiteral("初始化中");
    else if(state=="update")nfc=QStringLiteral("更新模式");
    else if(state=="card_emulation")nfc=QStringLiteral("正在模拟卡片");
    infoDetails->setText(QStringLiteral("固件版本：v%1    芯片：%2\n构建时间：%3    ESP-IDF：%4\nPN7150：%5（本次查询快照）\n%6：%7")
        .arg(info.value("version").toString(),info.value("target").toString(),info.value("built").toString(),
             info.value("idf").toString(),nfc,hash.size()==64?QStringLiteral("ELF SHA256"):QStringLiteral("ELF SHA256 前缀"),hash));
    infoDetails->setToolTip(info.value("firmware").toString());infoDetails->show();
    infoStatus->setStyleSheet("color:#16803d;");infoStatus->setText(QStringLiteral("查询成功 · 信息不会自动刷新"));refreshButtons();
}
void FirmwareUpdatePage::install() {
    if(busy || requested || infoQueryPending)return;
    QString path=QFileDialog::getOpenFileName(this,QStringLiteral("选择 SKPass 应用固件"),{},QStringLiteral("应用固件 (*.bin *.uf2)"));if(path.isEmpty())return;
    installFile(path);
}
void FirmwareUpdatePage::installFile(const QString &path) {
    if(busy || requested || infoQueryPending || romBusy)return;
    if(selectedMethod==1){rom->selectFirmware(path);return;}
    selectedFile=QFileInfo(path).fileName();dragActive=false;
    busy=true;refreshButtons();progress->setValue(0);status->setStyleSheet({});
    status->setText(QStringLiteral("正在校验 %1 并查找 UF2 磁盘，请保持设备供电；可继续使用侧边栏。 ").arg(QFileInfo(path).fileName()));
    QPointer<FirmwareUpdatePage> guard(this);
    auto result=std::make_shared<UpdateResult>();
    auto worker=QThread::create([guard,path,result]{
        auto report=[guard](int value){if(guard)QMetaObject::invokeMethod(guard,[guard,value]{if(guard)guard->progress->setValue(value);},Qt::QueuedConnection);};
        result->error=prepareAndCopy(path,report,result->automaticRestart);
    });
    connect(worker,&QThread::finished,this,[this,result]{finishUpdate(result->error,result->automaticRestart);});
    connect(worker,&QThread::finished,worker,&QObject::deleteLater);worker->start();
}
void FirmwareUpdatePage::refreshButtons() {
    const bool idle=!busy && !requested && !infoQueryPending && !romBusy;
    choose->setEnabled(idle);
    enter->setEnabled(idle && reader->canUpdate());
    queryInfo->setEnabled(idle && reader->isConnected());
    rom->setExternalBusy(busy || requested || infoQueryPending);
    emit updateActivityChanged(updateInProgress());
    refreshDropZone();
}
bool FirmwareUpdatePage::updateInProgress() const {return busy || requested || romBusy;}
void FirmwareUpdatePage::refreshDropZone() {
    dropZone->setProperty("dragActive",dragActive);
    dropZone->setProperty("unavailable",busy || requested || infoQueryPending);
    dropZone->setCursor(busy || requested || infoQueryPending?Qt::ArrowCursor:Qt::PointingHandCursor);
    dropZone->style()->unpolish(dropZone);dropZone->style()->polish(dropZone);dropZone->update();
    if(busy) {
        dropTitle->setText(QStringLiteral("正在校验并更新固件"));dropDetails->setText(selectedFile);
        dropAction->setText(QStringLiteral("请保持设备供电，可切换其他页面"));
    } else if(requested) {
        dropTitle->setText(QStringLiteral("正在进入更新模式"));dropDetails->setText(QStringLiteral("等待 SKPASS_UF2 磁盘出现后再添加固件"));
        dropAction->setText(QStringLiteral("请稍候…"));
    } else if(dragActive) {
        dropTitle->setText(QStringLiteral("松开鼠标，开始固件更新"));dropDetails->setText(QStringLiteral("文件将先经过校验，再写入读卡器"));
        dropAction->setText(QStringLiteral("支持 .BIN / .UF2"));
    } else {
        dropTitle->setText(QStringLiteral("将固件文件拖到这里"));
        dropDetails->setText(QStringLiteral("支持单个 .BIN / .UF2 应用固件 · 松开后开始校验并更新"));
        dropAction->setText(QStringLiteral("也可点击此区域选择文件"));
    }
}
bool FirmwareUpdatePage::eventFilter(QObject *object,QEvent *event) {
    if(object==dropZone && !busy && !requested && !infoQueryPending) {
        if(event->type()==QEvent::MouseButtonRelease && static_cast<QMouseEvent*>(event)->button()==Qt::LeftButton) {
            install();return true;
        }
        if(event->type()==QEvent::KeyPress) {
            auto key=static_cast<QKeyEvent*>(event);
            if(!key->isAutoRepeat() && (key->key()==Qt::Key_Return || key->key()==Qt::Key_Enter || key->key()==Qt::Key_Space)) {install();return true;}
        }
    }
    return QWidget::eventFilter(object,event);
}
void FirmwareUpdatePage::finishUpdate(const QString &error,bool automaticRestart) {
    busy=false;requested=false;dragActive=false;requestTimeout->stop();refreshButtons();
    if(error.isEmpty())progress->setValue(100);
    status->setStyleSheet(error.isEmpty()?"color:#16803d;":"color:#b42318;");
    status->setText(error.isEmpty()?(automaticRestart?
        QStringLiteral("更新成功：设备已校验并选定新固件，正在自动重启；上位机将自动重连，无需拔插。"):
        QStringLiteral("更新成功：设备已校验并选定新固件。当前运行的是旧更新器，请按设备复位键或断开全部供电后重新上电，再连接读卡器。")):error);
    if(error.isEmpty() && automaticRestart)reader->waitForFirmwareReconnect();
    emit updateFinished(error.isEmpty());
}
QString FirmwareUpdatePage::droppedFile(const QMimeData *mime) {
    if(!mime->hasUrls() || mime->urls().size()!=1)return {};
    const auto url=mime->urls().first();
    if(!url.isLocalFile())return {};
    const auto path=url.toLocalFile();const auto suffix=QFileInfo(path).suffix();
    return suffix.compare("bin",Qt::CaseInsensitive)==0 || suffix.compare("uf2",Qt::CaseInsensitive)==0?path:QString();
}
void FirmwareUpdatePage::dragEnterEvent(QDragEnterEvent *event) {
    if(!busy && !requested && !infoQueryPending && !romBusy && !droppedFile(event->mimeData()).isEmpty()) {
        dragActive=true;refreshDropZone();event->acceptProposedAction();
    }
    else {dragActive=false;refreshDropZone();event->ignore();}
}
void FirmwareUpdatePage::dragLeaveEvent(QDragLeaveEvent *event) {
    dragActive=false;refreshDropZone();event->accept();
}
void FirmwareUpdatePage::dropEvent(QDropEvent *event) {
    dragActive=false;refreshDropZone();
    const auto path=droppedFile(event->mimeData());
    if(busy || requested || infoQueryPending || romBusy || path.isEmpty()){event->ignore();return;}
    event->acceptProposedAction();installFile(path);
}
